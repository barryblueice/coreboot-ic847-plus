## src/mainboard/RSODIUM/Kconfig
```kconfig
## SPDX-License-Identifier: GPL-2.0-only

if VENDOR_RSODIUM

source "src/mainboard/RSODIUM/*/Kconfig.name"
source "src/mainboard/RSODIUM/*/Kconfig"

endif
```

## src/mainboard/RSODIUM/widget/Kconfig
```kconfig
## SPDX-License-Identifier: GPL-2.0-only

if BOARD_RSODIUM_WIDGET

config BOARD_SPECIFIC_OPTIONS
	def_bool y
	select NORTHBRIDGE_INTEL_SANDYBRIDGE
	select SOUTHBRIDGE_INTEL_C216
	select CPU_INTEL_MODEL_206AX
	select USE_NATIVE_RAMINIT
	select HAVE_ACPI_TABLES
	select HAVE_ACPI_RESUME
	select BOARD_ROMSIZE_KB_8192
	select MAINBOARD_HAS_LIBGFXINIT
	select INTEL_GMA_HAVE_VBT
	select GFX_GMA_IGNORE_PRESENCE_STRAPS
	select MAINBOARD_USES_IFD_GBE_REGION
	select HAVE_OPTION_TABLE
	# Return to S0 (power on) after a G3/power-cycle event.
	#
	# The onboard ME is in an abnormal state (Manufacturing Mode, MFS
	# failure, Recovery / Security Override via Jumper). In that state the
	# ME escalates ordinary host resets into a global / "pseudo-global"
	# reset that transitions the whole platform through Moff/G3. After that
	# cycle, GEN_PMCON_3 bit0 (state-after-G3) decides S0 vs S5.
	#
	# If the default is "S5 off after G3" (and CMOS is invalid, so the
	# runtime power_on_after_fail option falls back to this Kconfig
	# default), the board stays in S5 and every reboot - including a
	# firmware-internal one - ends as a shutdown. Defaulting to "on" makes
	# the board come back to S0 after the ME's global reset.
	select POWER_STATE_DEFAULT_ON_AFTER_FAILURE

config MAINBOARD_DIR
	default "RSODIUM/widget"

config MAINBOARD_PART_NUMBER
	default "IC847-PLUS"

config GFX_GMA_PANEL_1_PORT
	default "Disabled"

# Use a custom FMAP with an enlarged CONSOLE region (2MB) so the full
# EDK2 payload cbmem log can be captured to SPI flash for debugging.
config FMDFILE
	default "src/mainboard/$(CONFIG_MAINBOARD_DIR)/board.fmd"

config CONSOLE_SPI_FLASH_BUFFER_SIZE
	default 0x200000

config CONSOLE_CBMEM_BUFFER_SIZE
	default 0x200000

endif
```

## src/mainboard/RSODIUM/widget/Kconfig.name
```kconfig
## SPDX-License-Identifier: GPL-2.0-only

config BOARD_RSODIUM_WIDGET
	bool "IC847-PLUS"
	help
	  R-SODIUM Technology IC847-PLUS mainboard with Intel QS77
	  Panther Point PCH and Sandy Bridge / Ivy Bridge CPU.
```
